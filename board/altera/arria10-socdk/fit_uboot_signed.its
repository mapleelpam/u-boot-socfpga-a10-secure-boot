## board/altera/arria10-socdk/fit_uboot_signed.its
```
// SPDX-License-Identifier: GPL-2.0
 /*
 * Copyright (C) 2019 Intel Corporation <www.intel.com>
 *
 */

/dts-v1/;

/ {
	description = "FIT image with boot binaries";
	#address-cells = <1>;

	images {
		standalone {
			description = "U-Boot (32-bit)";
			data = /incbin/("u-boot-dtb.bin");
			type = "standalone";
			os = "u-boot";
			arch = "arm";
			compression = "none";
			load = <0x01000040>;
			entry = <0x01000040>;
			hash-1{
				algo ="sha256";
			};
		};
	};

	configurations {
		default = "conf";
		conf {
			description = "Intel Arria10 SoCDK";
			standalone = "standalone";
			signature {
				algo ="sha256,rsa2048";
				key-name-hint ="first_key";
				sign-images="standalone";
			};
		};
	};
};
```

## configs/socfpga_arria10_secure_boot_defconfig
```kconfig
CONFIG_ARM=y
CONFIG_ARCH_SOCFPGA=y
CONFIG_ENV_SIZE=0x2000
CONFIG_ENV_OFFSET=0x4400
CONFIG_DM_GPIO=y
CONFIG_SPL_TEXT_BASE=0xFFE00000
CONFIG_SPL_DRIVERS_MISC_SUPPORT=y
CONFIG_SPL_FIT_SOURCE="board/altera/arria10-socdk/fit_uboot_signed.its"
CONFIG_SPL_FAT_SUPPORT=y
CONFIG_SPL_SHA1_SUPPORT=y
CONFIG_SPL_SHA256_SUPPORT=y
CONFIG_SPL_CRYPTO_SUPPORT=y
CONFIG_SPL_HASH_SUPPORT=y
CONFIG_TARGET_SOCFPGA_ARRIA10_SOCDK=y
CONFIG_SHA1_SUPPORT=y
CONFIG_SHA256_SUPPORT=y
CONFIG_OF_LIST="socfpga_arria10_socdk_sdmmc"
CONFIG_AES=y
CONFIG_RSA=y
CONFIG_RSA_VERIFY=y
CONFIG_RSA_SOFTWARE_EXP=y
CONFIG_IMAGE_SIGN_INFO=y
# CONFIG_TARGET_SOCFPGA_DM_SOCDK is not set
# CONFIG_TARGET_SOCFPGA_AGILEX_SOCDK is not set
# CONFIG_TARGET_SOCFPGA_ARIES_MCVEVK is not set
CONFIG_IDENT_STRING="socfpga_arria10"
CONFIG_SPL_FS_FAT=y
CONFIG_DEFAULT_DEVICE_TREE="socfpga_arria10_socdk_sdmmc"
CONFIG_DISTRO_DEFAULTS=y
CONFIG_FIT=y
# CONFIG_USE_SPL_FIT_GENERATOR is not set
CONFIG_FIT_SIGNATURE=y
CONFIG_FIT_SIGNATURE_MAX_SIZE=0x10000000
CONFIG_FIT_CIPHER=y
CONFIG_FIT_VERBOSE=y
CONFIG_CMD_FAT=y
CONFIG_SPL=y
CONFIG_SPL_FIT=y
CONFIG_SPL_FIT_PRINT=y
CONFIG_SPL_FIT_SIGNATURE=y
CONFIG_SPL_LOAD_FIT=y
CONFIG_SPL_LOAD_FIT_FULL=y
CONFIG_USE_BOOTARGS=y
CONFIG_BOOTARGS="root=/dev/mmcblk0p2 rw rootwait earlyprintk console=ttyS0,115200n8"
CONFIG_BOOTCOMMAND="run prog_core;bridge enable;setenv bootargs \"root=/dev/mmcblk0p2 rw rootwait earlyprintk console=ttyS0,115200n8\";load mmc 0:1 ${loadaddr} os.itb;bootm ${loadaddr}"
CONFIG_DEFAULT_FDT_FILE="socfpga_arria10_socdk_sdmmc.dtb"
CONFIG_SYS_CONSOLE_IS_IN_ENV=y
CONFIG_SYS_CONSOLE_OVERWRITE_ROUTINE=y
CONFIG_SYS_CONSOLE_ENV_OVERWRITE=y
CONFIG_HASH=y
CONFIG_DISPLAY_BOARDINFO_LATE=y
CONFIG_SPL_RSA=y
CONFIG_SPL_RSA_VERIFY=y
CONFIG_SPL_FRAMEWORK=y
CONFIG_SPL_ENV_SUPPORT=y
CONFIG_SPL_FPGA_SUPPORT=y
CONFIG_SPL_FPGA=y
CONFIG_CMD_ASKENV=y
CONFIG_CMD_GREPENV=y
# CONFIG_CMD_FLASH is not set
CONFIG_CMD_FPGA_LOADMK=y
CONFIG_CMD_GPIO=y
CONFIG_CMD_MMC=y
CONFIG_CMD_USB=y
CONFIG_CMD_CACHE=y
CONFIG_CMD_EXT4_WRITE=y
CONFIG_MTDIDS_DEFAULT="nor0=ff705000.spi.0"
CONFIG_OF_SPL_REMOVE_PROPS="interrupts interrupt-parent dmas dma-names"
CONFIG_ENV_IS_IN_MMC=y
CONFIG_SYS_RELOC_GD_ENV_ADDR=y
CONFIG_VERSION_VARIABLE=y
CONFIG_SPL_DM_SEQ_ALIAS=y
CONFIG_DWAPB_GPIO=y
CONFIG_FS_LOADER=y
CONFIG_DM_MMC=y
CONFIG_MMC_DW=y
CONFIG_MTD=y
CONFIG_PHY_MICREL=y
CONFIG_PHY_MICREL_KSZ90X1=y
CONFIG_DM_ETH=y
CONFIG_ETH_DESIGNWARE=y
CONFIG_MII=y
CONFIG_NET_RANDOM_ETHADDR=y
CONFIG_SPI=y
CONFIG_TIMER=y
CONFIG_SPL_TIMER=y
CONFIG_DESIGNWARE_APB_TIMER=y
CONFIG_USB=y
CONFIG_DM_USB=y
CONFIG_USB_DWC2=y
# CONFIG_USE_TINY_PRINTF is not set

CONFIG_OF_LIBFDT=y
CONFIG_OF_LIBFDT_ASSUME_MASK=0x0
CONFIG_SPL_OF_LIBFDT=y
CONFIG_SPL_OF_LIBFDT_ASSUME_MASK=0x0
CONFIG_SPL_RTC_SUPPORT=y
CONFIG_SPL_GZIP=y
```
